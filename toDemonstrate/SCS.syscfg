/**
 * @cliArgs --board "/ti/boards/CC3220SF_LAUNCHXL" --product "simplelink_cc32xx_sdk@4_20_00_07"
 * @versions {"data":"2020052512","timestamp":"2020052512","tool":"1.5.0+1397","templates":"2020052512"}
 */

/**
 * Import the modules used in this configuration.
 */
const GPIO   = scripting.addModule("/ti/drivers/GPIO");
const GPIO1  = GPIO.addInstance();
const GPIO2  = GPIO.addInstance();
const GPIO3  = GPIO.addInstance();
const GPIO4  = GPIO.addInstance();
const GPIO5  = GPIO.addInstance();
const GPIO6  = GPIO.addInstance();
const GPIO7  = GPIO.addInstance();
const GPIO8  = GPIO.addInstance();
const GPIO9  = GPIO.addInstance();
const GPIO10 = GPIO.addInstance();
const RTOS   = scripting.addModule("/ti/drivers/RTOS");
const Timer  = scripting.addModule("/ti/drivers/Timer", {}, false);
const Timer1 = Timer.addInstance();
const Timer2 = Timer.addInstance();
const UART   = scripting.addModule("/ti/drivers/UART");
const UART1  = UART.addInstance();

/**
 * Write custom configuration values to the imported modules.
 */
GPIO1.$hardware = system.deviceData.board.components.LED_RED;
GPIO1.$name     = "CONFIG_GPIO_LED_0";

GPIO2.$name           = "CONFIG_GPIO_0";
GPIO2.gpioPin.$assign = "boosterpack.18";

GPIO3.$name           = "CONFIG_GPIO_1";
GPIO3.gpioPin.$assign = "boosterpack.4";

GPIO4.$name           = "CONFIG_GPIO_2";
GPIO4.gpioPin.$assign = "boosterpack.5";

GPIO5.$name           = "CONFIG_GPIO_3";
GPIO5.gpioPin.$assign = "boosterpack.7";

GPIO6.$name           = "CONFIG_GPIO_4";
GPIO6.gpioPin.$assign = "boosterpack.8";

GPIO7.$name           = "CONFIG_GPIO_5";
GPIO7.gpioPin.$assign = "boosterpack.13";

GPIO8.$name           = "CONFIG_GPIO_6";
GPIO8.gpioPin.$assign = "boosterpack.14";

GPIO9.$name           = "CONFIG_GPIO_7";
GPIO9.gpioPin.$assign = "boosterpack.15";

GPIO10.$hardware = system.deviceData.board.components.LED_GREEN;
GPIO10.$name     = "CONFIG_GPIO_LED_1";

const Power          = scripting.addModule("/ti/drivers/Power", {}, false);
Power.parkPins.$name = "ti_drivers_power_PowerCC32XXPins0";

RTOS.name = "FreeRTOS";

Timer1.$name         = "CONFIG_TIMER_0";
Timer1.timer.$assign = "Timer0";

Timer2.$name         = "CONFIG_TIMER_1";
Timer2.timer.$assign = "Timer1";

UART1.$name              = "CONFIG_UART_0";
UART1.uart.txPin.$assign = "boosterpack.28";

/**
 * Pinmux solution for unlocked pins/peripherals. This ensures that minor changes to the automatic solver in a future
 * version of the tool will not impact the pinmux you originally saw.  These lines can be completely deleted in order to
 * re-solve from scratch.
 */
GPIO1.gpioPin.$suggestSolution    = "boosterpack.29";
GPIO10.gpioPin.$suggestSolution   = "boosterpack.10";
UART1.uart.$suggestSolution       = "UART0";
UART1.uart.rxPin.$suggestSolution = "boosterpack.17";
